## configs/lepotato_defconfig
```kconfig
# Architecture
BR2_aarch64=y
BR2_cortex_a53=y
BR2_ARM_FPU_VFPV4=y

# Image
BR2_ROOTFS_POST_BUILD_SCRIPT="board/librecomputer/lepotato/post-build.sh"
BR2_ROOTFS_POST_IMAGE_SCRIPT="board/librecomputer/lepotato/post-image.sh"

# Kernel
BR2_LINUX_KERNEL=y
BR2_LINUX_KERNEL_CUSTOM_VERSION=y
BR2_LINUX_KERNEL_CUSTOM_VERSION_VALUE="6.6.32"
BR2_LINUX_KERNEL_USE_ARCH_DEFAULT_CONFIG=y
BR2_LINUX_KERNEL_DTS_SUPPORT=y
BR2_LINUX_KERNEL_INTREE_DTS_NAME="amlogic/meson-gxl-s905x-libretech-cc"
BR2_LINUX_KERNEL_INSTALL_TARGET=y
BR2_LINUX_KERNEL_NEEDS_HOST_OPENSSL=y

# For kernel modules autoloading
BR2_ROOTFS_DEVICE_CREATION_DYNAMIC_MDEV=y

# System
BR2_SYSTEM_DHCP="eth0"
BR2_GLOBAL_PATCH_DIR="board/librecomputer/lepotato/patches"
BR2_DOWNLOAD_FORCE_CHECK_HASHES=y

# Linux headers same as kernel, a 6.6 series
BR2_PACKAGE_HOST_LINUX_HEADERS_CUSTOM_6_6=y

# Filesystem
BR2_TARGET_ROOTFS_EXT2=y
BR2_TARGET_ROOTFS_EXT2_4=y
BR2_TARGET_ROOTFS_EXT2_SIZE="128M"

# Bootloader
BR2_TARGET_UBOOT=y
BR2_TARGET_UBOOT_BUILD_SYSTEM_KCONFIG=y
BR2_TARGET_UBOOT_CUSTOM_VERSION=y
BR2_TARGET_UBOOT_CUSTOM_VERSION_VALUE="2024.04"
BR2_TARGET_UBOOT_BOARD_DEFCONFIG="libretech-cc"
BR2_TARGET_UBOOT_NEEDS_OPENSSL=y

# Required tool to sign the bootloader image
BR2_PACKAGE_HOST_AMLOGIC_BOOT_FIP=y
BR2_PACKAGE_HOST_AMLOGIC_BOOT_FIP_DEVICE="lepotato"

# Required tools to create the SD image
BR2_PACKAGE_DOSFSTOOLS=y
BR2_PACKAGE_HOST_GENIMAGE=y
BR2_PACKAGE_HOST_MTOOLS=y
BR2_PACKAGE_HOST_DOSFSTOOLS=y
```

## package/bcachefs-tools/Config.in
```kconfig
config BR2_PACKAGE_BCACHEFS_TOOLS
	bool "bcachefs-tools"
	depends on BR2_USE_MMU # util-linux, keyutils
	depends on BR2_TOOLCHAIN_HAS_THREADS # liburcu
	depends on !BR2_STATIC_LIBS # keyutils
	depends on BR2_PACKAGE_HAS_UDEV
	depends on BR2_PACKAGE_LIBURCU_ARCH_SUPPORTS
	depends on BR2_INSTALL_LIBSTDCPP # liburcu
	select BR2_PACKAGE_KEYUTILS
	select BR2_PACKAGE_LIBAIO
	select BR2_PACKAGE_LIBSODIUM
	select BR2_PACKAGE_LIBURCU
	select BR2_PACKAGE_LZ4
	select BR2_PACKAGE_UTIL_LINUX
	select BR2_PACKAGE_UTIL_LINUX_LIBBLKID
	select BR2_PACKAGE_UTIL_LINUX_LIBUUID
	select BR2_PACKAGE_ZLIB
	select BR2_PACKAGE_ZSTD
	help
	  Bcachefs filesystem utilities

	  https://bcachefs.org/

comment "bcachefs-tools needs udev"
	depends on BR2_USE_MMU
	depends on BR2_PACKAGE_LIBURCU_ARCH_SUPPORTS
	depends on !BR2_PACKAGE_HAS_UDEV

comment "bcachefs-tools needs a toolchain w/ threads, C++, dynamic library"
	depends on BR2_USE_MMU
	depends on BR2_PACKAGE_LIBURCU_ARCH_SUPPORTS
	depends on !BR2_TOOLCHAIN_HAS_THREADS || \
		BR2_STATIC_LIBS || \
		!BR2_INSTALL_LIBSTDCPP
```

## package/freescale-imx/firmware-sentinel/Config.in
```kconfig
config BR2_PACKAGE_FIRMWARE_SENTINEL
	bool "firmware-sentinel"
	depends on BR2_PACKAGE_FREESCALE_IMX_PLATFORM_IMX91 || \
		BR2_PACKAGE_FREESCALE_IMX_PLATFORM_IMX93
	help
	  Firmware blobs for the i.MX9 Edgelock secure enclave (ELE).

	  This library is provided by Freescale as-is and doesn't have
	  an upstream.

if BR2_PACKAGE_FIRMWARE_SENTINEL

choice
	prompt "i.MX Sentinel Firmware Release"
	help
	  Select the appropriate ahab container image to install
	  to match the iMX asics revision.

	  Note - mismatches result in a failure to boot

config BR2_PACKAGE_FIRMWARE_SENTINEL_A0
	bool "A0"

config BR2_PACKAGE_FIRMWARE_SENTINEL_A1
	bool "A1"

endchoice

config BR2_PACKAGE_FIRMWARE_SENTINEL_AHAB_CONTAINER_IMAGE
	string
	default "mx93a0-ahab-container.img" if BR2_PACKAGE_FIRMWARE_SENTINEL_A0
	default "mx93a1-ahab-container.img" if BR2_PACKAGE_FIRMWARE_SENTINEL_A1

endif # BR2_PACKAGE_FIRMWARE_SENTINEL
```
